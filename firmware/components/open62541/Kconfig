## firmware/components/open62541/Kconfig
```kconfig
menu "open62541"

    config OPEN62541_ALOCAR_PSRAM
        bool "Alocar a memória do open62541 na PSRAM"
        depends on SPIRAM
        default y
        help
            Redireciona UA_malloc/UA_calloc/UA_realloc/UA_free para a PSRAM,
            preservando a SRAM interna para Wi-Fi, lwIP e pilhas das tasks.
            Se a PSRAM estiver cheia, a alocação cai para a SRAM interna.

endmenu
```

## firmware/main/Kconfig.projbuild
```kconfig
menu "TCC PoC"

    config TCC_WIFI_SSID
        string "SSID da rede Wi-Fi (2,4 GHz)"
        default ""
        help
            Defina em sdkconfig.local (fora do git) para não publicar a credencial.

    config TCC_WIFI_PASSWORD
        string "Senha da rede Wi-Fi"
        default ""
        help
            Defina em sdkconfig.local (fora do git) para não publicar a credencial.

    config TCC_WIFI_ECONOMIA_ENERGIA
        bool "Economia de energia do Wi-Fi (modem sleep)"
        default y
        help
            Ligado: o rádio dorme entre os beacons do roteador (menor consumo, maior latência).
            Desligado: o rádio fica sempre ativo (menor latência). Para um equipamento
            alimentado pela rede elétrica, desligar costuma ser a melhor escolha.

    config TCC_OPCUA_PORT
        int "Porta do servidor OPC UA"
        default 4840

endmenu
```
